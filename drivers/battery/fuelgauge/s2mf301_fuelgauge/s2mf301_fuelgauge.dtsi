/*
 * s2mf301 battery device tree common
 *
 * Copyright (c) 2022 Samsung Electronics Co., Ltd.
 *		http://www.samsung.com
 *
 * This program is free software; you can redistribute it and/or modify
 * it under the terms of the GNU General Public License version 2 as
 * published by the Free Software Foundation.
 */

&smd {
	s2mf301_fuelgauge: s2mf301-fuelgauge {
		status = "okay";
		fuelgauge,capacity_full = <5000>;
		fuelgauge,low_voltage_limit_lowtemp = <3100>;
		fuelgauge,fuel_alert_soc = <1>;
		fuelgauge,capacity_max = <1000>;
		fuelgauge,capacity_max_margin = <200>;
		fuelgauge,capacity_min = <0>;
		fuelgauge,capacity_calculation_type = <28>;
		fuelgauge,use_external_temp;
#if 1
		fuelgauge,bat_id_gpio = <
				SEC_GPIO_REF(PM,s2mpu14_gpio,gpio_s,8) 0  /* BAT_ID_1 */
				>;
#elif 0
		fuelgauge,bat_id_gpio = <
				SEC_GPIO_REF(${bat_id_gpio_02}) 0  /* BAT_ID_2 */
				SEC_GPIO_REF(${bat_id_gpio_01}) 0  /* BAT_ID_1 */
				>;
#endif
	};
};

&smd {
	battery {
		battery,fgsrc_switch_name = "s2mf301-fuelgauge"; /* Fuelgauge voltage source */
	};
};


/* /home/dpi/qb5_8814/workspace/P4_1716/android/kernel/kmodule/battery/suwon/fuelgauge/s2mf301/a26xs/s2mf301_fuelgauge.dtsi */
/*
 * s2mf301 battery device tree common
 *
 * Copyright (c) 2022 Samsung Electronics Co., Ltd.
 *		http://www.samsung.com
 *
 * This program is free software; you can redistribute it and/or modify
 * it under the terms of the GNU General Public License version 2 as
 * published by the Free Software Foundation.
 */

&smd {
	s2mf301_fuelgauge: s2mf301-fuelgauge {
		status = "okay";
		fuelgauge,capacity_full = <5000>;
		fuelgauge,low_voltage_limit_lowtemp = <3100>;
		fuelgauge,fuel_alert_soc = <1>;
		fuelgauge,capacity_max = <1000>;
		fuelgauge,capacity_max_margin = <200>;
		fuelgauge,capacity_min = <0>;
		fuelgauge,capacity_calculation_type = <28>;
		fuelgauge,use_external_temp;
		/* zadj data [0x12] [0x13] [0x15] */
		fuelgauge1,zadj_data = <
			/* zadj data for 4.48 */
			0 0 0
			/* zadj data for 4.46 */
			0 0 0
			/* zadj data for 4.44 */
			0 0 0
			/* zadj data for 4.42 */
			0 0 0
			/* zadj data for 4.37 */
			0 0 0
			>;
		fuelgauge0,zadj_data = <
			/* zadj data for 4.48 */
			0 0 0
			/* zadj data for 4.46 */
			0 0 0
			/* zadj data for 4.44 */
			0 0 0
			/* zadj data for 4.42 */
			0 0 0
			/* zadj data for 4.37 */
			0 0 0
			>;
#if 0
		fuelgauge,bat_id_gpio = <
				SEC_GPIO_REF(${bat_id_gpio_02}) 0  /* BAT_ID_2 */
				SEC_GPIO_REF(${bat_id_gpio_01}) 0  /* BAT_ID_1 */
				>;
#endif
	};
};

&smd {
	battery {
		battery,fgsrc_switch_name = "s2mf301-fuelgauge"; /* Fuelgauge voltage source */
	};
};

&smd {
	s2mf301_battery_params: battery_params {
	/*
	 * BAT_ID_1
	 * 1: ATL_safe, normal
	 * 0: SDI, BYD
	 */

	/* 1: ATL_safe */
		battery1,battery_data = <
			/***** battery data for 4.45 *****/
			/* battery,battery_table3 */
			190 11 78 11 222 10 108 10 241 9
			117 9 254 8 144 8 43 8 206 7
			76 7 252 6 195 6 149 6 112 6
			81 6 37 6 245 5 181 5 140 5
			224 4 75 1 105 8 0 8 151 7
			46 7 198 6 93 6 244 5 139 5
			34 5 186 4 81 4 232 3 127 3
			23 3 174 2 69 2 220 1 115 1
			11 1 162 0 57 0 239 15

			/* battery,battery_table4 */
			14 14 14 14 28 27 27 27 27 28
			28 28 28 29 29 29 29 29 29 30
			30 154

			/* battery,batcap */
			0x50 0x50 0xb8 0xb /* [0x0E] [0x0F] [0x10] [0x11] */

			/* battery,designcap */
			0x50 0x50 /* [0x86~0x87] */

			/* battery,batcap_ocv_new */
			0x51 0x50 /* 0x90~0x91 */

			/* battery,soc_arr_val */
			10512 10000 9488 8977 8465 7954 7442 6930 6418 5907
			5395 4883 4372 3860 3348 2836 2325 1813 1302 790
			279 (-85)

			/* battery,ocv_arr_val */
			44677 44130 43583 43027 42426 41822 41243 40701 40209 39755
			39120 38729 38453 38230 38048 37897 37679 37449 37132 36931
			36096 31614

			/* battery,rRS_CC0 */
			0x15 /* [0x5C] */

			/***** battery data for 4.43 *****/
			/* battery,battery_table3 */
			190 11 78 11 222 10 108 10 241 9
			117 9 254 8 144 8 43 8 206 7
			76 7 252 6 195 6 149 6 112 6
			81 6 37 6 245 5 181 5 140 5
			224 4 75 1 137 8 30 8 180 7
			74 7 223 6 117 6 11 6 160 5
			54 5 204 4 97 4 247 3 141 3
			34 3 184 2 77 2 227 1 121 1
			15 1 164 0 58 0 238 15

			/* battery,battery_table4 */
			14 14 14 14 14 27 27 27 27 28
			28 28 28 29 29 29 29 29 29 30
			30 154

			/* battery,batcap */
			0x20 0x4f 0xf4 0xc /* [0x0E] [0x0F] [0x10] [0x11] */

			/* battery,designcap */
			0x20 0x4f /* [0x86~0x87] */

			/* battery,batcap_ocv_new */
			0x21 0x4f /* 0x90~0x91 */

			/* battery,soc_arr_val */
			10667 10148 9629 9109 8590 8071 7552 7032 6513 5994
			5475 4955 4436 3917 3398 2878 2359 1840 1321 802
			283 (-87)

			/* battery,ocv_arr_val */
			44677 44130 43583 43027 42426 41822 41243 40701 40209 39755
			39120 38729 38453 38230 38048 37897 37679 37449 37132 36931
			36096 31614

			/* battery,rRS_CC0 */
			0x15 /* [0x5C] */

			/***** battery data for 4.41 *****/
			/* battery,battery_table3 */
			190 11 78 11 222 10 108 10 241 9
			117 9 254 8 144 8 43 8 206 7
			76 7 252 6 195 6 149 6 112 6
			81 6 37 6 245 5 181 5 140 5
			224 4 75 1 179 8 71 8 218 7
			110 7 1 7 149 6 41 6 188 5
			80 5 227 4 119 4 10 4 158 3
			50 3 197 2 89 2 237 1 128 1
			20 1 167 0 59 0 238 15

			/* battery,battery_table4 */
			14 14 14 14 14 27 27 27 27 28
			28 28 28 29 29 29 29 29 29 30
			30 154

			/* battery,batcap */
			0xa0 0x4d 0xb5 0xc  /* [0x0E] [0x0F] [0x10] [0x11] */

			/* battery,designcap */
			0xa0 0x4d /* [0x86~0x87] */

			/* battery,batcap_ocv_new */
			0xa1 0x4d /* 0x90~0x91 */

			/* battery,soc_arr_val */
			10873 10344 9815 9286 8757 8228 7698 7169 6639 6110
			5581 5051 4522 3993 3464 2934 2405 1876 1346 817
			288 (-88)

			/* battery,ocv_arr_val */
			44677 44130 43583 43027 42426 41822 41243 40701 40209 39755
			39120 38729 38453 38230 38048 37897 37679 37449 37132 36931
			36096 31614

			/* battery,rRS_CC0 */
			0x15 /* [0x5C] */

			/***** battery data for 4.39 *****/
			/* battery,battery_table3 */
			190 11 78 11 222 10 108 10 241 9
			117 9 254 8 144 8 43 8 206 7
			76 7 252 6 195 6 149 6 112 6
			81 6 37 6 245 5 181 5 140 5
			224 4 75 1 225 8 115 8 4 8
			149 7 39 7 184 6 74 6 219 5
			108 5 253 4 143 4 32 4 177 3
			67 3 212 2 101 2 247 1 136 1
			26 1 171 0 60 0 238 15

			/* battery,battery_table4 */
			14 14 14 14 14 27 27 27 27 28
			28 28 28 29 29 29 29 29 29 30
			30 154

			/* battery,batcap */
			0x0C 0x4C 0x73 0xc /* [0x0E] [0x0F] [0x10] [0x11] */

			/* battery,designcap */
			0x0C 0x4C /* [0x86~0x87] */

			/* battery,batcap_ocv_new */
			0x0D 0x4C /* 0x90~0x91 */

			/* battery,soc_arr_val */
			11100 10560 10020 9480 8939 8399 7859 7318 6778 6238
			5697 5157 4616 4076 3536 2995 2455 1915 1375 834
			294  (-90)

			/* battery,ocv_arr_val */
			44677 44130 43583 43027 42426 41822 41243 40701 40209 39755
			39120 38729 38453 38230 38048 37897 37679 37449 37132 36931
			36096 31614

			/* battery,rRS_CC0 */
			0x15 /* [0x5C] */

			/***** battery data for 4.34 *****/
			/* battery,battery_table3 */
			190 11 78 11 222 10 108 10 241 9
			117 9 254 8 144 8 43 8 206 7
			76 7 252 6 195 6 149 6 112 6
			81 6 37 6 245 5 181 5 140 5
			224 4 75 1 82 9 222 8 106 8
			246 7 130 7 13 7 153 6 37 6
			177 5 61 5 201 4 84 4 224 3
			108 3 248 2 132 2 16 2 156 1
			39 1 179 0 63 0 237 15

			/* battery,battery_table4 */
			14 14 14 14 14 14 27 27 27 28
			28 28 28 29 29 29 29 29 29 30
			30 154

			/* battery,batcap */
			0x74 0x48 0xdc 0xb /* [0x0E] [0x0F] [0x10] [0x11] */

			/* battery,designcap */
			0x74 0x48 /* [0x86~0x87] */

			/* battery,batcap_ocv_new */
			0x75 0x48 /* 0x90~0x91 */

			/* battery,soc_arr_val */
			11651 11084 10516 9949 9382 8815 8248 7681 7114 6547
			5980 5412 4845 4278 3711 3144 2577 2010 1443 876
			309  (-94)

			/* battery,ocv_arr_val */
			44677 44130 43583 43027 42426 41822 41243 40701 40209 39755
			39120 38729 38453 38230 38048 37897 37679 37449 37132 36931
			36096 31614

			/* battery,rRS_CC0 */
			0x15 /* [0x5C] */

			>;
	/* 0: SDI */
		battery0,battery_data = <
			/***** battery data for 4.45 *****/
			/* battery,battery_table3 */
			188 11 73 11 214 10 96 10 227 9
			102 9 238 8 127 8 24 8 179 7
			53 7 235 6 179 6 134 6 98 6
			64 6 13 6 224 5 153 5 128 5
			40 4 74 1 106 8 0 8 150 7
			44 7 195 6 89 6 239 5 133 5
			27 5 178 4 72 4 222 3 116 3
			10 3 160 2 55 2 205 1 99 1
			249 0 143 0 38 0 244 15

			/* battery,battery_table4 */
			16 16 16 16 31 31 31 30 30 30
			31 31 31 31 31 32 32 32 33 34
			36 154

			/* battery,batcap */
			0x00 0x50 0xb8 0xb /* [0x0E] [0x0F] [0x10] [0x11] */

			/* battery,designcap */
			0x00 0x50 /* [0x86~0x87] */

			/* battery,batcap_ocv_new */
			0x01 0x50 /* 0x90~0x91 */

			/* battery,soc_arr_val */
			10517 10000 9483 8967 8450 7933 7417 6900 6383 5867
			5350 4834 4317 3800 3284 2767 2250 1734 1217 700
			184 (-57)

			/* battery,ocv_arr_val */
			44666 44105 43544 42971 42357 41748 41164 40620 40118 39625
			39011 38646 38375 38156 37979 37815 37564 37342 36998 36876
			35196 31613

			/* battery,rRS_CC0 */
			0x17 /* [0x5C] */

			/***** battery data for 4.43 *****/
			/* battery,battery_table3 */
			188 11 73 11 214 10 96 10 227 9
			102 9 238 8 127 8 24 8 179 7
			53 7 235 6 179 6 134 6 98 6
			64 6 13 6 224 5 153 5 128 5
			40 4 74 1 136 8 28 8 177 7
			70 7 219 6 111 6 4 6 153 5
			45 5 194 4 87 4 236 3 128 3
			21 3 170 2 63 2 211 1 104 1
			253 0 145 0 38 0 244 15

			/* battery,battery_table4 */
			16 16 16 16 16 31 31 30 30 30
			31 31 31 31 31 32 32 32 33 34
			36 154

			/* battery,batcap */
			0xe0 0x4e 0xd7 0xc /* [0x0E] [0x0F] [0x10] [0x11] */

			/* battery,designcap */
			0xe0 0x4e /* [0x86~0x87] */

			/* battery,batcap_ocv_new */
			0xe1 0x4e /* 0x90~0x91 */

			/* battery,soc_arr_val */
			10662 10138 9615 9091 8567 8043 7519 6996 6472 5948
			5424 4900 4377 3853 3329 2805 2281 1758 1234 710
			186 (-58)

			/* battery,ocv_arr_val */
			44666 44105 43544 42971 42357 41748 41164 40620 40118 39625
			39011 38646 38375 38156 37979 37815 37564 37342 36998 36876
			35196 31613

			/* battery,rRS_CC0 */
			0x17 /* [0x5C] */

			/***** battery data for 4.41 *****/
			/* battery,battery_table3 */
			188 11 73 11 214 10 96 10 227 9
			102 9 238 8 127 8 24 8 179 7
			53 7 235 6 179 6 134 6 98 6
			64 6 13 6 224 5 153 5 128 5
			40 4 74 1 178 8 69 8 216 7
			106 7 253 6 143 6 34 6 181 5
			71 5 218 4 109 4 255 3 146 3
			36 3 183 2 74 2 220 1 111 1
			2 1 148 0 39 0 244 15

			/* battery,battery_table4 */
			16 16 16 16 16 31 31 30 30 30
			31 31 31 31 31 32 32 32 33 34
			36 154

			/* battery,batcap */
			0x5c 0x4d 0x98 0xc  /* [0x0E] [0x0F] [0x10] [0x11] */

			/* battery,designcap */
			0x5c 0x4d /* [0x86~0x87] */

			/* battery,batcap_ocv_new */
			0x5d 0x4d /* 0x90~0x91 */

			/* battery,soc_arr_val */
			10870 10336 9802 9268 8734 8200 7666 7132 6598 6064
			5530 4996 4462 3928 3394 2860 2326 1792 1258 724
			190 (-59)

			/* battery,ocv_arr_val */
			44666 44105 43544 42971 42357 41748 41164 40620 40118 39625
			39011 38646 38375 38156 37979 37815 37564 37342 36998 36876
			35196 31613

			/* battery,rRS_CC0 */
			0x17 /* [0x5C] */

			/***** battery data for 4.39 *****/
			/* battery,battery_table3 */
			188 11 73 11 214 10 96 10 227 9
			102 9 238 8 127 8 24 8 179 7
			53 7 235 6 179 6 134 6 98 6
			64 6 13 6 224 5 153 5 128 5
			40 4 74 1 223 8 111 8 0 8
			144 7 32 7 177 6 65 6 210 5
			98 5 243 4 131 4 20 4 164 3
			53 3 197 2 85 2 230 1 118 1
			7 1 151 0 40 0 244 15

			/* battery,battery_table4 */
			16 16 16 16 16 31 31 30 30 30
			31 31 31 31 31 32 32 32 33 34
			36 154

			/* battery,batcap */
			0xd8 0x4b 0x59 0xc /* [0x0E] [0x0F] [0x10] [0x11] */

			/* battery,designcap */
			0xd8 0x4b /* [0x86~0x87] */

			/* battery,batcap_ocv_new */
			0xd9 0x4b /* 0x90~0x91 */

			/* battery,soc_arr_val */
			11087 10542 9998 9453 8908 8364 7819 7274 6730 6185
			5640 5096 4551 4006 3462 2917 2372 1828 1283 738
			194 (-61)

			/* battery,ocv_arr_val */
			44666 44105 43544 42971 42357 41748 41164 40620 40118 39625
			39011 38646 38375 38156 37979 37815 37564 37342 36998 36876
			35196 31613

			/* battery,rRS_CC0 */
			0x17 /* [0x5C] */

			/***** battery data for 4.34 *****/
			/* battery,battery_table3 */
			188 11 73 11 214 10 96 10 227 9
			102 9 238 8 127 8 24 8 179 7
			53 7 235 6 179 6 134 6 98 6
			64 6 13 6 224 5 153 5 128 5
			40 4 74 1 75 9 214 8 97 8
			236 7 119 7 2 7 141 6 25 6
			164 5 47 5 186 4 69 4 208 3
			92 3 231 2 114 2 253 1 136 1
			19 1 158 0 42 0 243 15

			/* battery,battery_table4 */
			16 16 16 16 16 15 31 30 30 30
			31 31 31 31 31 32 32 32 33 34
			36 154

			/* battery,batcap */
			0x68 0x48 0xc9 0xb /* [0x0E] [0x0F] [0x10] [0x11] */

			/* battery,designcap */
			0x68 0x48 /* [0x86~0x87] */

			/* battery,batcap_ocv_new */
			0x69 0x48 /* 0x90~0x91 */

			/* battery,soc_arr_val */
			11614 11044 10473 9902 9332 8761 8191 7620 7050 6479
			5909 5338 4767 4197 3626 3056 2485 1915 1344 773
			203 (-63)

			/* battery,ocv_arr_val */
			44666 44105 43544 42971 42357 41748 41164 40620 40118 39625
			39011 38646 38375 38156 37979 37815 37564 37342 36998 36876
			35196 31613

			/* battery,rRS_CC0 */
			0x17 /* [0x5C] */
			>;
	};
};

/* /home/dpi/qb5_8814/workspace/P4_1716/android/kernel/kmodule/battery/suwon/fuelgauge/s2mf301/a26xs/s2mf301_fuelgauge.05.dtsi */
/* Battery data same as s2mf301_fuelgauge.dtsi*/