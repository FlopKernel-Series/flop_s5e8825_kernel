## drivers/battery/charger/nu2111a_charger/Kconfig
```kconfig
config CHARGER_NU2111A
	tristate "NU2111A charger driver"
	default n
	depends on DIRECT_CHARGING
	help
	  Say Y or M here,
	  to enable support for the NU2111A charger.
	  This is 2:1 switched capacitor direct charger.
	  To compile the driver as a module, choose M here.

config SEND_PDMSG_IN_PPS_REQUEST_WORK
	bool "NU2111A send pdmsg in request work"
	default n
	help
	  Say Y here to enable
	  support for send pdmsg in direct charger.
	  This options for pdic not support periodic send pdmsg.
	  If this is Y in direct charger, direct charger send pdmsg periodic.
```

## drivers/battery/charger/sm5714_charger/Kconfig
```kconfig
config CHARGER_SM5714
	tristate "SM5714 battery charger support"
	default n
	help
	  Say Y here to enable support for the SM5714 charger
	  SM5714 is charger systems for lithium-ion (Li+) batteries
	  in handheld and portable equipment.
```

## drivers/gpu/drm/samsung/panel/Kconfig
```kconfig
config USDM_PANEL
	tristate "Samsung MX Panel Driver"
	select BACKLIGHT_CLASS_DEVICE
	default n
	help
		Enable USDM Panel Driver.

config USDM_MDNIE
	bool "Support MDNIE LITE"
	depends on USDM_PANEL
	default n

config USDM_MDNIE_AFC
	bool "Support AFC"
	depends on USDM_PANEL && USDM_MDNIE
	default n

config USDM_PANEL_SYSFS
	bool "Support LCD SYSFS"
	depends on USDM_PANEL
	default y

config USDM_COPR_SPI
	bool "Support LCD SPI"
	depends on USDM_PANEL
	default n

config USDM_PANEL_COPR
	bool "Support COPR"
	depends on USDM_PANEL
	default n

config USDM_MDNIE_TUNING
	bool "Support LCD TUNING"
	depends on USDM_PANEL
	default n

config USDM_PANEL_DIMMING
	bool "Support AID Dimming"
	depends on USDM_PANEL
	default y

config USDM_PANEL_MULTI_RESOLUTION
	bool "Support DSU(Multi Resolution)"
	depends on USDM_PANEL
	default n

config USDM_PANEL_HMD
	bool "Support HMD(Head Mount Display - VR)"
	depends on USDM_PANEL
	default n

config USDM_PANEL_LPM
	bool "Support LPM(Low Power Mode) Driver"
	depends on USDM_PANEL
	default n

config USDM_PANEL_SELF_DISPLAY
	bool "Support Extend Live Clock Functions(For Always On Display)"
	depends on USDM_PANEL
	default n

config USDM_PANEL_AOD_BL
	bool "Support AOD(Always On Display) BL(BackLight) Driver"
	depends on USDM_PANEL && USDM_PANEL_LPM
	default n

config USDM_PANEL_DDI_FLASH
	bool "Support display ddi flash"
	depends on USDM_PANEL
	default n

config USDM_PANEL_POC_FLASH
	bool "Support display poc flash"
	depends on USDM_PANEL
	default n

config USDM_PANEL_MAFPC
	bool "SUPPORT MAFPC function"
	depends on USDM_PANEL
	default n

config USDM_PANEL_MAFPC_CRC
	bool "SUPPORT MAFPC CRC function"
	depends on USDM_PANEL
	default n

config USDM_PANEL_DIM_FLASH
	bool "Support display dimming flash"
	depends on USDM_PANEL && USDM_PANEL_DDI_FLASH
	default n

config USDM_FACTORY_GCT_TEST
	bool "Support GRAM Checksum"
	depends on USDM_PANEL
	default n

config USDM_FACTORY_CCD_TEST
	bool "Support CCD TEST"
	depends on USDM_PANEL
	default n

config USDM_FACTORY_SSR_TEST
	bool "Support SSR TEST"
	depends on USDM_PANEL
	default n

config USDM_FACTORY_ECC_TEST
	bool "Support ECC TEST"
	depends on USDM_PANEL
	default n

config USDM_PANEL_BACKLIGHT_PAC_3_0
	bool "Support baclight PAC 3.0"
	depends on USDM_PANEL
	default n

config USDM_PANEL_DPUI
	bool "Support display use info logging"
	depends on USDM_PANEL
	default n

config USDM_POC_SPI
	bool "Support poc SPI connection"
	depends on USDM_PANEL
	default n

config USDM_PANEL_GM2_FLASH
	bool "Support to get Gamma-mode2 panel info from flash"
	depends on USDM_PANEL
	default n

config USDM_PANEL_FREQ_HOP
	bool "Support Panel Frequency Hopping"
	depends on USDM_PANEL
	default n

config USDM_PANEL_DISPLAY_MODE
	bool "Support panel display mode"
	depends on USDM_PANEL
	default n

config USDM_FACTORY
	bool "mcd-panel for factory binary"
	depends on USDM_PANEL
	default SEC_FACTORY

config USDM_FACTORY_FAST_DISCHARGE
	bool "Support fast discharge function"
	depends on USDM_PANEL && USDM_FACTORY
	default n

config USDM_PANEL_DEBUG
	bool "Support panel debug"
	depends on USDM_PANEL
	default y

config USDM_PANEL_MASK_LAYER
	bool "Support FP mask layer function"
	depends on USDM_PANEL
	default n

config USDM_PANEL_ERRFG_RECOVERY
	bool "Support ERRFG recovery"
	depends on USDM_PANEL
	default n

config USDM_FACTORY_MST_TEST
	bool "Support MST Test"
	depends on USDM_PANEL
	default n

config USDM_FACTORY_BRIGHTDOT_TEST
	bool "Support Brightdot Test"
	depends on USDM_PANEL
	default n

config USDM_FACTORY_VGLHIGHDOT_TEST
	bool "Support VGL Highdot Test"
	depends on USDM_PANEL
	default n

config USDM_TCON_PRE_EMPHASIS_TEST
	bool "Support TCON Pre Emphasis Test"
	depends on USDM_PANEL
	default n

config USDM_FACTORY_DSC_CRC_TEST
	bool "Support panel decoder test"
	depends on USDM_PANEL
	default n

config USDM_PANEL_EVASION_DISP_DET
    bool "Support avoid disp_det interrupt"
    depends on USDM_PANEL
    default n

config USDM_DDI_CMDLOG
	bool "Support DDI Command Log"
	depends on USDM_PANEL
	default n

config USDM_BLIC_I2C
	bool "Support mcd panel i2c"
	depends on USDM_PANEL
	default n

config USDM_PANEL_BLIC
	bool "Support mcd panel blic"
	depends on USDM_PANEL
	default n

config USDM_PANEL_BIG_LOCK
	bool "Support mcd panel big lock"
	depends on USDM_PANEL
	default n

config USDM_PANEL_RCD
	bool "Support mcd panel rcd"
	depends on USDM_PANEL && !USDM_FACTORY
	default n

config USDM_PANEL_ID_READ_REG_04
	bool "Using ID READ Register 04h"
	depends on USDM_PANEL
	default n

config USDM_PANEL_ID_READ_REG_DADBDC
	bool "Using ID READ Register DA/DB/DCh"
	depends on USDM_PANEL
	default n

config USDM_PANEL_ID_READ_REG_ADAEAF
	bool "Using ID READ Register AD/AE/AFh"
	depends on USDM_PANEL
	default n

config USDM_PANEL_ID_READ_BY_LPDT
	bool "Using ID READ by LPDT"
	depends on USDM_PANEL
	default n

config USDM_PANEL_ID_READ_BY_HSDT
	bool "Using ID READ by HSDT"
	depends on USDM_PANEL
	default n

config USDM_PANEL_TESTMODE
	bool "SUPPORT PANEL TEST MODE"
	depends on USDM_PANEL && !SAMSUNG_PRODUCT_SHIP
	default n

config USDM_PANEL_JSON
	bool "Support mcd panel json parser/writer"
	depends on USDM_PANEL
	default n

config USDM_PANEL_VCOM_TRIM_TEST
	bool "Support VCOM TRIM test"
	depends on USDM_PANEL
	default n

config USDM_LPD_AUTO_BR
	bool "Support lpd auto brightness"
	depends on USDM_PANEL
	default n

config USDM_ADAPTIVE_MIPI
	bool "Support Adaptive MIPI"
	depends on USDM_PANEL
	default n

config USDM_SDP_ADAPTIVE_MIPI
	bool "Support SDP Adaptive MIPI"
	depends on USDM_PANEL
	depends on SDP
	default n

config USDM_USE_CUSTOM_SOFTDEP
	bool "Support Custom softdep"
	depends on USDM_PANEL
	default n

config USDM_PANEL_UEVENT_RECOVERY
	bool "Support uevent recovery"
	depends on USDM_PANEL
	default n

config USDM_PANEL_LATE_PROBE
	bool "Support Late Probe"
	depends on USDM_PANEL
	default n

config LPD_OLED_COMPENSATION
	bool "Support OLED DeburnIn for Watch"
	depends on USDM_PANEL
	default n

config USDM_PANEL_FIRMWARE_UPDATE
	bool "Support FW update for T-CON"
	depends on USDM_PANEL
	default n

########## FOR KUNIT ##########

config PANEL_TEST
	bool "KUnit test for panel"
	depends on SEC_KUNIT && UML
	help
	  TODO: Describe config fully.

config PANEL_MAPTBL_TEST
	bool "KUnit test for panel maptbl"
	depends on SEC_KUNIT && UML
	help
	  TODO: Describe config fully.

config PANEL_UTIL_TEST
	bool "KUnit test for panel utilities"
	depends on SEC_KUNIT && UML
	help
	  TODO: Describe config fully.

config PANEL_ABD_TEST
	bool "KUnit test for panel abd"
	depends on SEC_KUNIT && UML
	help
	  TODO: Describe config fully.

config PANEL_DRV_IOCTL_TEST
	bool "KUnit test for panel_drv_ioctl"
	depends on SEC_KUNIT && UML
	help
	  TODO: Describe config fully.

config PANEL_DRV_TEST
	bool "KUnit test for panel_drv"
	depends on SEC_KUNIT && UML
	help
	  TODO: Describe config fully.

config PANEL_GPIO_TEST
	bool "KUnit test for panel_gpio"
	depends on SEC_KUNIT && UML
	help
	  TODO: Describe config fully.

config PANEL_REGULATOR_TEST
	bool "KUnit test for panel_regulator"
	depends on SEC_KUNIT && UML
	help
	  TODO: Describe config fully.

config PANEL_DEBUG_TEST
	bool "KUnit test for panel_debug"
	depends on SEC_KUNIT && UML
	depends on USDM_PANEL_DEBUG
	help
	  TODO: Describe config fully.

config PANEL_BL_TEST
	bool "KUnit test for panel_bl"
	depends on SEC_KUNIT && UML
	help
	  TODO: Describe config fully.

config PANEL_IRC_TEST
	bool "KUnit test for panel_irc"
	depends on SEC_KUNIT && UML
	help
	  TODO: Describe config fully.

config PANEL_MODES_TEST
	bool "KUnit test for panel_modes"
	depends on SEC_KUNIT && UML
	depends on USDM_PANEL_DISPLAY_MODE
	help
	  TODO: Describe config fully.

config PANEL_POC_TEST
	bool "KUnit test for panel_poc"
	depends on SEC_KUNIT && UML
	depends on USDM_POC_SPI
	help
	  TODO: Describe config fully.

config PANEL_SPI_TEST
	bool "KUnit test for panel_spi"
	depends on SEC_KUNIT && UML
	depends on USDM_POC_SPI
	help
	  TODO: Describe config fully.

config PANEL_VRR_TEST
	bool "KUnit test for panel_vrr"
	depends on SEC_KUNIT && UML
	help
	  TODO: Describe config fully.

config SYSFS_TEST
	bool "KUnit test for sysfs"
	depends on SEC_KUNIT && UML
	depends on USDM_PANEL_SYSFS
	help
	  TODO: Describe config fully.

config MDNIE_TEST
	bool "KUnit test for mdnie"
	depends on SEC_KUNIT && UML
	depends on USDM_MDNIE
	help
	  TODO: Describe config fully.

config COPR_TEST
	bool "KUnit test for copr"
	depends on SEC_KUNIT && UML
	depends on USDM_PANEL_COPR
	help
	  TODO: Describe config fully.

config DIMMING_TEST
	bool "KUnit test for dimming"
	depends on SEC_KUNIT && UML
	help
	  TODO: Describe config fully.

config DPUI_TEST
	bool "KUnit test for dpui"
	depends on SEC_KUNIT && UML
	depends on USDM_PANEL_DPUI
	help
	  TODO: Describe config fully.

config TIMENVAL_TEST
	bool "KUnit test for timenval"
	depends on SEC_KUNIT && UML
	help
	  TODO: Describe config fully.

config AOD_DRV_TEST
	bool "KUnit test for aod_drv"
	depends on SEC_KUNIT && UML
	depends on USDM_PANEL_SELF_DISPLAY
	help
	  TODO: Describe config fully.

config MAFPC_DRV_TEST
	bool "KUnit test for mafpc_drv"
	depends on SEC_KUNIT && UML
	depends on USDM_PANEL_MAFPC
	help
	  TODO: Describe config fully.

config PANEL_FREQ_HOP_TEST
	bool "KUnit test for panel_freq_hop"
	depends on SEC_KUNIT && UML
	depends on USDM_PANEL_FREQ_HOP
	help
	  TODO: Describe config fully.

config PANEL_LIB_TEST
	bool "KUnit test for panel_lib"
	depends on SEC_KUNIT && UML
	help
	  TODO: Describe config fully.

config PANEL_POWER_CTRL_TEST
	bool "KUnit test for panel_power_ctrl"
	depends on SEC_KUNIT && UML
	help
	  TODO: Describe config fully.

config PANEL_I2C_TEST
	bool "KUnit test for panel_I2C"
	depends on SEC_KUNIT && UML
	help
	  TODO: Describe config fully.

config PANEL_BLIC_TEST
	bool "KUnit test for panel_BLIC"
	depends on SEC_KUNIT && UML
	help
	  TODO: Describe config fully.

config PANEL_OBJ_TEST
	bool "KUnit test for panel_obj"
	depends on SEC_KUNIT && UML
	help
	  TODO: Describe config fully.

config PANEL_FUNCTION_TEST
	bool "KUnit test for panel_function"
	depends on SEC_KUNIT && UML
	help
	  TODO: Describe config fully.

config PANEL_PROPERTY_TEST
	bool "KUnit test for panel_property"
	depends on SEC_KUNIT && UML
	help
	  TODO: Describe config fully.

config PANEL_CONFIG_TEST
	bool "KUnit test for panel_config"
	depends on SEC_KUNIT && UML
	help
	  TODO: Describe config fully.

config JSMN_TEST
	bool "KUnit test for jsmn"
	depends on SEC_KUNIT && UML && USDM_PANEL_JSON
	help
	  TODO: Describe config fully.

config JSON_TEST
	bool "KUnit test for json parser"
	depends on SEC_KUNIT && UML && USDM_PANEL_JSON
	help
	  TODO: Describe config fully.

config JSON_WRITER_TEST
	bool "KUnit test for json_writer"
	depends on SEC_KUNIT && UML && USDM_PANEL_JSON
	help
	  TODO: Describe config fully.

config JSON_READER_TEST
	bool "KUnit test for json_reader"
	depends on SEC_KUNIT && UML && USDM_PANEL_JSON
	help
	  TODO: Describe config fully.

config PANEL_JSON_TEST
	bool "KUnit test for panel_json"
	depends on SEC_KUNIT && UML && USDM_PANEL_JSON
	help
	  TODO: Describe config fully.

config PANEL_SEQUENCE_TEST
	bool "KUnit test for panel_sequence"
	depends on SEC_KUNIT && UML
	help
	  TODO: Describe config fully.

config PANEL_EXPRESSION_TEST
	bool "KUnit test for panel_expression"
	depends on SEC_KUNIT && UML
	help
	  TODO: Describe config fully.

config PANEL_CONDITION_TEST
	bool "KUnit test for panel_condition"
	depends on SEC_KUNIT && UML
	help
	  TODO: Describe config fully.

config PANEL_DELAY_TEST
	bool "KUnit test for panel_delay"
	depends on SEC_KUNIT && UML
	help
	  TODO: Describe config fully.

config PANEL_PACKET_TEST
	bool "KUnit test for panel_packet"
	depends on SEC_KUNIT && UML
	help
	  TODO: Describe config fully.

config PANEL_RESOURCE_TEST
	bool "KUnit test for panel_resource"
	depends on SEC_KUNIT && UML
	help
	  TODO: Describe config fully.

config PANEL_DUMP_TEST
	bool "KUnit test for panel_dump"
	depends on SEC_KUNIT && UML
	help
	  TODO: Describe config fully.

config PANEL_TESTMODE_TEST
	bool "KUnit test for panel_testmode"
	depends on SEC_KUNIT && UML
	depends on USDM_PANEL_TESTMODE
	help
	  TODO: Describe config fully.

config PANEL_LPD_CMD_TEST
	bool "KUnit test for lpd"
	depends on SEC_KUNIT && UML
	depends on USDM_LPD_AUTO_BR
	help
	  TODO: Describe config fully.

config PANEL_ADAPTIVE_MIPI_TEST
	bool "KUint test for adaptive mipi"
	depends on SEC_KUNIT && UML
	depends on USDM_ADAPTIVE_MIPI
	help
	  TODO: Describe config fully.

config SDP_ADAPTIVE_MIPI_TEST
	bool "KUint test for SDP adaptive mipi"
	depends on SEC_KUNIT && UML
	depends on SDP
	help
	  TODO: Describe config fully.
```

## drivers/gpu/drm/samsung/panel/db7f2010b/Kconfig
```kconfig
menuconfig USDM_PANEL_DB7F2010B
	tristate "DB7F2010B DDI Panel Driver"
	depends on USDM_PANEL
	depends on USDM_PANEL_OLED_COMMON
	default n
	help
		This enables DB7F2010B DDI dependent panel drivers of
		common panel driver. say Y, if you have a panel based on
		the DB7F2010B DDI.


########## FOR KUNIT ##########

config DB7F2010B_TEST
	bool "KUnit test for db7f2010b ddi driver"
	depends on SEC_KUNIT
	help
	  TODO: Describe config fully.
```

## drivers/gpu/drm/samsung/panel/oled_common/Kconfig
```kconfig
menuconfig USDM_PANEL_OLED_COMMON
	tristate "OLED_COMMON DDI Panel Driver"
	depends on USDM_PANEL
	default y
	help
		This enables OLED_COMMON DDI dependent panel drivers of
		common panel driver. say Y, if you have a panel based on
		the OLED_COMMON DDI.


########## FOR KUNIT ##########

config OLED_COMMON_TEST
	bool "KUnit test for oled_common ddi driver"
	depends on SEC_KUNIT
	help
	  TODO: Describe config fully.

config OLED_COMMON_AOD_TEST
	bool "KUnit test for oled_common_aod ddi driver"
	depends on SEC_KUNIT
	depends on USDM_PANEL_SELF_DISPLAY
	help
	  TODO: Describe config fully.

config OLED_COMMON_COND_TEST
	bool "KUnit test for oled_common_cond ddi driver"
	depends on SEC_KUNIT
	help
	  TODO: Describe config fully.

config OLED_COMMON_DUMP_TEST
	bool "KUnit test for oled_common_dump ddi driver"
	depends on SEC_KUNIT
	help
	  TODO: Describe config fully.

config OLED_COMMON_MDNIE_TEST
	bool "KUnit test for oled_common_mdnie ddi driver"
	depends on SEC_KUNIT
	depends on USDM_MDNIE
	help
	  TODO: Describe config fully.

config OLED_FUNCTION_TEST
	bool "KUnit test for oled_function driver"
	depends on SEC_KUNIT
	help
	  TODO: Describe config fully.
```

## drivers/gpu/drm/samsung/panel/s6e8fc3/Kconfig
```kconfig
menuconfig USDM_PANEL_S6E8FC3
	tristate "S6E8FC3 DDI Panel Driver"
	depends on USDM_PANEL
	depends on USDM_PANEL_OLED_COMMON
	default n
	help
		This enables S6E8FC3 DDI dependent panel drivers of
		common panel driver. say Y, if you have a panel based on
		the S6E8FC3 DDI.


########## FOR KUNIT ##########

config S6E8FC3_TEST
	bool "KUnit test for s6e8fc3 ddi driver"
	depends on SEC_KUNIT
	help
	  TODO: Describe config fully.
```
