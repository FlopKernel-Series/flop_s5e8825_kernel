## drivers/staging/kshrink_lruvecd/Kconfig
```kconfig
config KSHRINK_LRUVECD
       tristate "Allow asynchronous shrink lruvec"
       default n
       help
         Asynchronous shrink lruvec optimization feature
```

## drivers/usb/typec/slsi/common/Kconfig
```kconfig
#
# PDIC devices
#

comment "PDIC configs"

config PDIC_SLSI_NON_MCU
	tristate "Using USBPD device driver"
	depends on I2C
	default n
	help
	  If you say yes here you will get support for
	  the S.LSI Non MCU USB PD(Power Delivery) device driver.

config PDIC_PD30
	bool "support PD30"
	depends on PDIC_SLSI_NON_MCU
	default n
	help
	  If you say yes here you will get support for PD30

config S2MU106_TYPEC_WATER
	bool "Using S2MU Type-C Water Detection"
	depends on I2C && (MFD_S2MU106 || PM_S2MU106)
	default n
	help
	  If you say yes here you will get support for
	  the S2MU Type-C Water functions.

config S2MU106_TYPEC_WATER_SBU
	bool "Using Type-C Water through SBU1/2"
	depends on I2C && (MFD_S2MU106 || PM_S2MU106 || S2MU106_TYPEC_WATER)
	default n
	help
	  If you say yes here you will get support for
	  the S2MU Type-C Water with SBU1/2 functions.

config S2MF301_TYPEC_WATER
	bool "Using S2MU Type-C Water Detection"
	depends on I2C && (MFD_S2MF301 || PM_S2MF301)
	default n
	help
	  If you say yes here you will get support for
	  the S2MU Type-C Water functions.

config S2MF301_TYPEC_WATER_DRY_CC_CHECK
	bool "Using S2MU Type-C Water Detection"
	depends on I2C && (MFD_S2MF301 || PM_S2MF301)
	default n
	help
	  If you say yes here you will get support for
	  the S2MU Type-C Water functions of dry with CC1/2 check.

config SUPPORT_USB_TYPEC_OPS
	bool "Using TYPEC OPS since kernel 5.4 version"
	default n
	help
	  If you say yes here you will get support for
	  the Type-C OPS.

config S2M_PDIC_MANUAL_RETRY
	bool "Using manual retry to avoid Alert-Req Colliion"
	default n
	help
	  If you say yes here you will get support for
	  manual retry to avoid alert-req collision

config S2M_PDIC_DP_SUPPORT
	bool "Using dp through pdic"
	default n
	help
	  If you say yes here you will get support for
	  displayport suppor vdm msg, notify
```
